## configs/pong_defconfig
```kconfig
# UniXNU Pong iOS 16 debug bring-up with standard XNU console capture.
# The boot packager selects 1..8 actual SM8475 CPU nodes (--cpus); PSCI starts them.
# Owner SystemCryptex remains mounted read-only at the path selected by the XNU hook.
CONFIG_XNU_ADRENO_FIRMWARE_PROBE=n
CONFIG_XNU_ADRENO_PM4_PROBE=n
CONFIG_XNU_ARMCPU=y
CONFIG_XNU_ARMVIRT_PLATFORM=n
CONFIG_XNU_ARM_DT_PLATFORM=y
CONFIG_XNU_BOOT_PROGRESS=n
CONFIG_XNU_BUILD_WERROR=n
CONFIG_XNU_CONSTANT_UPLOADS_PROBE=n
CONFIG_XNU_CRYPTO_BOOTSTRAP="prelinked"
CONFIG_XNU_DT_PANIC_REGION=y
CONFIG_XNU_NATIVE_ADRENO=n
CONFIG_XNU_NATIVE_AES=n
CONFIG_XNU_NATIVE_AIR_INIT=n
CONFIG_XNU_NATIVE_ARCH_TIMER=y
CONFIG_XNU_NATIVE_CS_HASH_CACHE=y
CONFIG_XNU_NATIVE_LEGACY_DISPLAY=n
CONFIG_XNU_NATIVE_MOBILE_DISPLAY=n
CONFIG_XNU_NATIVE_OFFLINE_GPU=n
CONFIG_XNU_NATIVE_PAN=y
CONFIG_XNU_NATIVE_RAM_BLOCK=n
CONFIG_XNU_NATIVE_TRUST_CACHE=n
CONFIG_XNU_NATIVE_UFS=y
CONFIG_XNU_NATIVE_VIRTIO_BLOCK=n
CONFIG_XNU_NATIVE_VIRTIO_CONSOLE=n
CONFIG_XNU_OWNER_BOOT_MANIFEST=n
CONFIG_XNU_OWNER_CACHE_CARRIER=n
CONFIG_XNU_OWNER_CACHE_CARRIER_WRONG_UUID=n
CONFIG_XNU_OWNER_CACHE_MOUNT=y
CONFIG_XNU_OWNER_CACHE_STARTUP=y
CONFIG_XNU_OWNER_CRYPTEX_FILES=y
CONFIG_XNU_OWNER_DATA_MOUNT=y
CONFIG_XNU_OWNER_DATA_UFS=y
CONFIG_XNU_OWNER_DATA_VOLUME_UUID="576A2203-F35D-45DA-80B0-11EF01DDA8C9"
CONFIG_XNU_OWNER_CACHE_VOLUME_UUID="15B507FA-21B7-4EE5-B55D-0F3445DE0752"
CONFIG_XNU_OWNER_ROOT_AUDIT=n
CONFIG_XNU_OWNER_ROOT_TRUST=n
CONFIG_XNU_OWNER_UNION_SYSTEMOS=n
CONFIG_XNU_PONG_APFS_DEBUG=y
CONFIG_XNU_PONG_ADRENO_PLATFORM=y
CONFIG_XNU_PONG_EARLY_TRACE=n
CONFIG_XNU_PONG_EARLY_EXCEPTION=n
CONFIG_XNU_PONG_ENTRY_RESET=n
CONFIG_XNU_PONG_ENTRY_STAGE=0
CONFIG_XNU_PONG_BOOT_STAGES=n
CONFIG_XNU_PONG_LEGACY_UACCESS=n
CONFIG_XNU_PONG_RAMOOPS_CONSOLE=y
CONFIG_XNU_PONG_VOLATILE_PANIC_LOG=y
CONFIG_XNU_SHENG_PMGR=n
CONFIG_XNU_SMMU4K_PROBE=n
CONFIG_XNU_SOURCE_CORECRYPTO14=n
CONFIG_XNU_SOURCE_MOCKFS=n
CONFIG_XNU_SOURCE_PTHREAD=n
CONFIG_XNU_TRUST_CACHE_RUNTIME=n
CONFIG_XNU_VERIFIED_ROOT_PROBE=n
CONFIG_XNU_ZONE_PGZ_ALIGNMENT_PROBE=n
```
